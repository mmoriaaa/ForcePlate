/************************************************************************************
*
* 功能说明：数码管的操作函数。
* 作者信息：品诺电子(http://free-design.taobao.com)
*
************************************************************************************/
#include "stc15f2k60s2.h"
#include "my_type.h"
#include "main.h"
#include "num.h" 

#define NUM_OE	P47
#define NUM_SER	P02
#define NUM_SCK	P45		//上升沿数据移位，下降沿不变
#define NUM_RCK	P11		//上升沿移位寄存器数据进入数据存储器，下降沿不变

code u8 numCode[]={//七段数码管显示0到F的编码表
	0x3f,0x06,0x5b,0x4f,0x66,0x6d,0x7d,0x07,0x7f,0x6f, /*显示0~9*/
	0x77,0x7c,0x39,0x5e,0x79,0x71, /*显示a~f*/
	0x00, /*八段全熄灭，显示空，地址0x10*/
	0x80, /*显示小数点，地址0x11*/
	0x40  /*显示中间横杠，地址0x12*/
};

static u8 displayNumCode[4]={0,0,0,0};	//全局变量，用于存储数码管的4个显示位的编码
static volatile u8 secondFlag=0;	//每秒置位1次

/********************************************************************
函数功能：往74HC595芯片的移位寄存器中写入一个bit并移位。
入口参数：b:待写入的bit。
返    回：无。
备    注：无。
********************************************************************/
void SetOneBit(u8 b)
{
	NUM_SCK=0;		//下降沿不变
	//Delay(1);
	NUM_SER=b;		//串行输入
	//Delay(1);
	NUM_SCK=1;		//上升沿数据移位
	//Delay(1);
}
/**///////////////////////Pino Electronics////////////////////////**/

/********************************************************************
函数功能：将位选和显示码值写入74HC595，刷新数码管的位选和显示值。
入口参数：无。
返    回：无。
备    注：5ms左右刷新一次，若刷新太慢了人眼会感觉出数码管的闪烁。
********************************************************************/
void RefreshNumDisplay(void)
{
	static u8 curCount=0;//表示当前刷新的是第几个位，数码管共有4个显示位
	u8 curDisplayNumCode;
	u8 i;

	NUM_RCK=0;			//上升沿移位寄存器数据进入数据存储器，下降沿不变
	curCount++;			//数码管共有4个显示位，故显示完一个数，数值加1
	if (curCount==4) 	//超过3则重新开始显示第0个
		curCount=0;
	for(i=0;i<4;i++){	//选择刷新数码管的第i位
		if(i==curCount)
			SetOneBit(0);
		else
			SetOneBit(1);
	}
	curDisplayNumCode=displayNumCode[curCount];	//取当前刷新的那个位的编码值
	for(i=0;i<8;i++){	//7段数码管加小数点，故有8位
		SetOneBit((curDisplayNumCode&0x80)>>7);		//将编码值的每一位移入74HC595的移位寄存器
		curDisplayNumCode<<=1;
	}
	NUM_RCK=1;	//移位寄存器的数据进入显示存储器
	//Delay(1);
	NUM_OE=0;		//使能显示，至此完成显示一个位
}
/**///////////////////////Pino Electronics////////////////////////**/

/********************************************************************
函数功能：将传进的参数number转换成十进制数，写入全局变量displayNum，用于数码管显示。
入口参数：number:要在数码管上显示的数值。
返    回：无。
备    注：无。
********************************************************************/
void SetNumDisplayDecimal(u16 number)
{
	u8 index[4];
	s8 i;
	
	index[3]=(number/1000);
	index[2]=(number%1000/100);
	index[1]=(number%100/10);
	index[0]=(number%10);
	for(i=3;i>=1;i--){	//高位是0时，0不显示出来，比如2不能显示成0002
		if(index[i]==0)
			index[i]=0x10;	//根据numCode[]，地址为0x10时显示空白
		else
			break;
	}
	for(i=3;i>=0;i--){
		if(number>9999)		//大于9999的数显示为横杠
			displayNumCode[i]=numCode[0x12];	//根据numCode[]，地址为0x12时显示横杠
		else
			displayNumCode[i]=numCode[index[i]];
	}
}
/**///////////////////////Pino Electronics////////////////////////**/

/********************************************************************
函数功能：将传进的参数number转换成十六进制数，写入全局变量displayNumCode，
		  用于数码管显示，显示一个无符号char型，即：两位十六进制数。
入口参数：number:要在数码管上显示的数值。
返    回：无。
备    注：无。
********************************************************************/
void SetNumDisplayHex8(u8 number)
{
	unsigned char index[4];

	index[3]=0x10;	//根据numCode[]，地址为0x10时显示空白
	index[2]=0x10;
	index[1]=((number>>4)&0x0f);
	index[0]=(number&0x0f);

	displayNumCode[3]=numCode[index[3]];	//当前位的数值的编码值
	displayNumCode[2]=numCode[index[2]];	
	displayNumCode[1]=numCode[index[1]];
	displayNumCode[0]=numCode[index[0]];
}
/**///////////////////////Pino Electronics////////////////////////**/

/********************************************************************
函数功能：将传进的参数number转换成十六进制数，写入全局变量displayNumCode，
		  用于数码管显示，显示一个无符号int型，即：四位十六进制数。
入口参数：number:要在数码管上显示的数值。
返    回：无。
备    注：无。
********************************************************************/
void SetNumDisplayHex16(u16 number)
{
	unsigned char index[4];

	index[3]=(number>>12);
	index[2]=((number>>8)&0x000f);
	index[1]=((number>>4)&0x000f);
	index[0]=(number&0x000f);

	displayNumCode[3]=numCode[index[3]];	//当前位的数值的编码值
	displayNumCode[2]=numCode[index[2]];	
	displayNumCode[1]=numCode[index[1]];
	displayNumCode[0]=numCode[index[0]];
}
/**///////////////////////Pino Electronics////////////////////////**/

/********************************************************************
函数功能：数码管显示空白。
入口参数：无。
返    回：无。
备    注：无。
********************************************************************/
void SetNumDisplayBlank(void)
{
	displayNumCode[3]=0;	
	displayNumCode[2]=0;	
	displayNumCode[1]=0;
	displayNumCode[0]=0;
}
/**///////////////////////Pino Electronics////////////////////////**/

/********************************************************************
函数功能：数码管当前显示的内容上增加小数点。
入口参数：u8 x:要增加小数点的位置，取0~3。
返    回：无。
备    注：无。
********************************************************************/
void SetNumDisplayDot(u8 i)
{
	if(i>3)//大于3则参数错误，返回
		return;
	displayNumCode[i]|=numCode[0x11];//根据numCode[]，地址为0x11时显示小数点
}
/**///////////////////////Pino Electronics////////////////////////**/

/********************************************************************
函数功能：初始化定时器0，每5ms产生一个中断。
入口参数：无。
返    回：无。
备    注：无。
********************************************************************/
void InitTimer0(void)
{
	
	//AUXR|=0x80;		//设置定时器0为1T模式，默认为12T模式
	TMOD&=(~0x03);	//设置Timer0工作在模式0(16位自动重载模式)

	/*系统时钟选择为22.1184M时， 重载值的计算如下：	  
	22118400/12分频/200=9216，即每计数9216耗时为5ms。*/	
	TH0 = (65536-SYSCLK/12/200)>>8;		//初始化Timer0重载值
	TL0 = (65536-SYSCLK/12/200);		//初始化Timer0重载值
	
	ET0=1;  		//Timer0中断使能
	TR0 = 1;		//Timer0开启
}
/**///////////////////////Pino Electronics////////////////////////**/

/********************************************************************
函数功能：定时器0的中断服务程序。
入口参数：无。
返    回：无。
备    注：中断标志位自动清除。
********************************************************************/
void Timer0ISR(void) interrupt 1
{		
	static u16 count=0;
	count++;
	RefreshNumDisplay();	//每5ms刷新一次数码管显示
	if(count==200){		//5ms一次中断，接收到200次中断即为1秒
		count=0;
		secondFlag=1;
	}
}
/**///////////////////////Pino Electronics////////////////////////**/

/********************************************************************
函数功能：查询secondFlag标志位。
入口参数：无。
返    回：u8:标志位有效，则返回1，否则返回0。
备    注：无。
********************************************************************/
 u8 GetSecondFlag(void)
{
	if(secondFlag){
		secondFlag=0;//清除标志位
		return 1;
	}else{
		return 0;
	}
}
/**///////////////////////Pino Electronics////////////////////////**/

